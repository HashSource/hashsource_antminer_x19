## br2_external_bitmain/Config.in
```kconfig
# Bitmain X19 Series Custom Packages Menu
# NOTE: Kernel modules are stock binaries in rootfs-overlay, not built from source
source "$BR2_EXTERNAL_X19_BITMAIN_PATH/packages/hashsource_x19/Config.in"
```

## br2_external_bitmain/configs/x19_xilinx_ramdisk_defconfig
```kconfig
# shellcheck disable=all

# Architecture
BR2_arm=y
BR2_cortex_a9=y
BR2_ARM_ENABLE_NEON=y
BR2_ARM_ENABLE_VFP=y
BR2_ARM_FPU_VFPV3D16=y

# Global patch directory for package patches
BR2_GLOBAL_PATCH_DIR="$(BR2_EXTERNAL_X19_BITMAIN_PATH)/board/x19_xilinx/patches"

# Toolchain - Linaro GCC 7.2-2017.11 (EXACT match for stock kernel modules)
# Stock kernel & modules were built with: gcc version 7.2.1 20171011 (Linaro GCC 7.2-2017.11)
# BR2_TOOLCHAIN_BUILDROOT is not set
BR2_TOOLCHAIN_EXTERNAL=y
BR2_TOOLCHAIN_EXTERNAL_CUSTOM=y
BR2_TOOLCHAIN_EXTERNAL_DOWNLOAD=y
BR2_TOOLCHAIN_EXTERNAL_URL="https://releases.linaro.org/components/toolchain/binaries/7.2-2017.11/arm-linux-gnueabihf/gcc-linaro-7.2.1-2017.11-x86_64_arm-linux-gnueabihf.tar.xz"
BR2_TOOLCHAIN_EXTERNAL_CUSTOM_PREFIX="arm-linux-gnueabihf"
BR2_TOOLCHAIN_EXTERNAL_GCC_7=y

# Enable toolchain features for GDB support
BR2_TOOLCHAIN_EXTERNAL_HAS_SSP=y
BR2_TOOLCHAIN_EXTERNAL_INET_RPC=y
BR2_TOOLCHAIN_EXTERNAL_CXX=y
BR2_TOOLCHAIN_EXTERNAL_HEADERS_4_6=y
BR2_TOOLCHAIN_EXTERNAL_CUSTOM_GLIBC=y
BR2_TOOLCHAIN_EXTERNAL_LOCALE=y
BR2_TOOLCHAIN_EXTERNAL_WCHAR=y

# System configuration
BR2_TARGET_GENERIC_HOSTNAME="HashSource"
BR2_TARGET_GENERIC_ISSUE="HashSource X19"
BR2_ROOTFS_DEVICE_CREATION_DYNAMIC_MDEV=y
BR2_ROOTFS_OVERLAY="$(BR2_EXTERNAL_X19_BITMAIN_PATH)/board/x19_xilinx/rootfs-overlay"
# Root password = "root" (for development/testing)
BR2_TARGET_GENERIC_ROOT_PASSWD="root"
BR2_SYSTEM_DHCP="eth0"
# Use bash as default shell
BR2_SYSTEM_BIN_SH_BASH=y

# Build options - optimize for size
BR2_OPTIMIZE_S=y
BR2_ENABLE_LTO=y

# NO BOOTLOADER - Using stock BOOT.bin from NAND
# BR2_TARGET_UBOOT is not set

# Kernel - Build 4.6 to provide source for kernel module compilation
# Note: We use the stock kernel from NAND, but need source tree for building modules
BR2_LINUX_KERNEL=y
BR2_LINUX_KERNEL_CUSTOM_TARBALL=y
BR2_LINUX_KERNEL_CUSTOM_TARBALL_LOCATION="https://cdn.kernel.org/pub/linux/kernel/v4.x/linux-4.6.tar.xz"
BR2_LINUX_KERNEL_DEFCONFIG="multi_v7"
BR2_LINUX_KERNEL_CONFIG_FRAGMENT_FILES="$(BR2_EXTERNAL_X19_BITMAIN_PATH)/board/x19_xilinx/linux-extra.config"
# Don't install kernel - we use stock
# BR2_LINUX_KERNEL_INSTALL_TARGET is not set

# Filesystem - ext4 ramdisk for FIT image packaging
BR2_TARGET_ROOTFS_EXT2=y
BR2_TARGET_ROOTFS_EXT2_4=y
BR2_TARGET_ROOTFS_EXT2_SIZE="32M"

# Essential packages only
BR2_PACKAGE_BUSYBOX=y
BR2_PACKAGE_BUSYBOX_CONFIG="$(BR2_EXTERNAL_X19_BITMAIN_PATH)/board/x19_xilinx/busybox.config"
BR2_PACKAGE_BUSYBOX_SHOW_OTHERS=y

# Shell
BR2_PACKAGE_BASH=y
BR2_PACKAGE_BASH_COMPLETION=y
BR2_PACKAGE_NCURSES=y
BR2_PACKAGE_READLINE=y

# Network tools
BR2_PACKAGE_DROPBEAR=y
BR2_PACKAGE_ETHTOOL=y
BR2_PACKAGE_ETHTOOL_PRETTY_PRINT=y

# System utilities
BR2_PACKAGE_I2C_TOOLS=y
BR2_PACKAGE_MTD=y
BR2_PACKAGE_MTD_NANDWRITE=y
BR2_PACKAGE_MTD_NANDDUMP=y
BR2_PACKAGE_MTD_FLASH_ERASE=y
BR2_PACKAGE_UTIL_LINUX=y
BR2_PACKAGE_UTIL_LINUX_BINARIES=y

# Debug tools
BR2_PACKAGE_GDB=y
BR2_PACKAGE_GDB_SERVER=y
BR2_PACKAGE_GDB_DEBUGGER=y
BR2_PACKAGE_GDB_TUI=y
BR2_PACKAGE_STRACE=y

# Host U-Boot tools with FIT support for ramdisk.itb creation
BR2_PACKAGE_HOST_UBOOT_TOOLS_FIT_SUPPORT=y

# Host genimage for SD card image creation
BR2_PACKAGE_HOST_GENIMAGE=y
BR2_PACKAGE_HOST_MTOOLS=y
BR2_PACKAGE_HOST_DOSFSTOOLS=y

# Custom X19 packages
# NOTE: Stock kernel modules are in rootfs-overlay, not built from source
BR2_PACKAGE_HASHSOURCE_X19=y
# Rust package (production deployment)
BR2_PACKAGE_HOST_RUSTC=y

# Build scripts
BR2_ROOTFS_POST_BUILD_SCRIPT="$(BR2_EXTERNAL_X19_BITMAIN_PATH)/board/x19_xilinx/post-build.sh"
BR2_ROOTFS_POST_IMAGE_SCRIPT="$(BR2_EXTERNAL_X19_BITMAIN_PATH)/board/x19_xilinx/post-image-ramdisk.sh"

# Host tools for FIT image creation
BR2_PACKAGE_HOST_DTC=y
BR2_PACKAGE_HOST_UBOOT_TOOLS=y
```

## br2_external_bitmain/packages/hashsource_x19/Config.in
```kconfig
config BR2_PACKAGE_HASHSOURCE_X19
	bool "hashsource_x19 (C build only)"
	help
	  HashSource custom mining software (C implementation)
	  Supports X19 Xilinx Zynq platform.
```
